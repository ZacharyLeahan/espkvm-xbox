## s3-dongle/components/esp_tinyusb/Kconfig
```kconfig
# SPDX-License-Identifier: Apache-2.0
rsource "../../../components/esp_tinyusb/Kconfig"
```

## s3-dongle/main/Kconfig.projbuild
```kconfig
# SPDX-License-Identifier: Apache-2.0
menu "Xbox S3 home network"
    config KVM_WIFI_DEFAULT_SSID
        string "Home Wi-Fi SSID"
        default ""
    config KVM_WIFI_DEFAULT_PASSWORD
        string "Home Wi-Fi password"
        default ""
    config KVM_XBOX_S3_KEY
        string "Private 64-character hexadecimal P4 pairing key"
        default ""
endmenu
```

## s3-dongle/sdkconfig.defaults
```kconfig
CONFIG_IDF_TARGET="esp32s3"
CONFIG_ESPTOOLPY_FLASHSIZE_4MB=y
CONFIG_ESP_CONSOLE_UART_DEFAULT=y
CONFIG_ESP_TASK_WDT_EN=y
CONFIG_HTTPD_MAX_REQ_HDR_LEN=1024
CONFIG_TINYUSB_CDC_ENABLED=n
CONFIG_TINYUSB_MSC_ENABLED=n
CONFIG_TINYUSB_HID_ENABLED=n
CONFIG_TINYUSB_KVM_MSC_CLASS=n
```
